## boards/shields/kinesis_adv/Kconfig.shield
```kconfig
config SHIELD_KINESIS_ADV_LEFT
    def_bool $(shields_list_contains,kinesis_adv_left)

config SHIELD_KINESIS_ADV_RIGHT
    def_bool $(shields_list_contains,kinesis_adv_right)
```

## boards/shields/kinesis_adv_split/Kconfig.defconfig
```kconfig
if SHIELD_KINESIS_ADV_LEFT

config ZMK_KEYBOARD_NAME
    default "kinesis_adv"

config ZMK_SPLIT_ROLE_CENTRAL
    default y

endif # SHIELD_KINESIS_ADV_LEFT

if SHIELD_KINESIS_ADV_LEFT || SHIELD_KINESIS_ADV_RIGHT

config ZMK_SPLIT
    default y

endif # SHIELD_KINESIS_ADV_LEFT || SHIELD_KINESIS_ADV_RIGHT
```

## boards/shields/kinesis_advantage/Kconfig.defconfig
```kconfig
if SHIELD_KINESIS_ADVANTAGE

config ZMK_KEYBOARD_NAME
    default "kinesis_adv"

endif # SHIELD_KINESIS_ADVANTAGE
```

## boards/shields/kinesis_advantage/Kconfig.shield
```kconfig
config SHIELD_KINESIS_ADVANTAGE
    def_bool $(shields_list_contains,kinesis_advantage)
```
